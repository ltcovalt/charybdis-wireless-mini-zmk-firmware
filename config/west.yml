## config/west.yml
```yaml
manifest:
  remotes:
    - name: zmkfirmware
      url-base: https://github.com/zmkfirmware
    - name: 280Zo
      url-base: https://github.com/280Zo
    - name: yamaryu211
      url-base: https://github.com/yamaryu211

  projects:
    - name: zmk
      remote: zmkfirmware
      revision: main
      import: app/west.yml
    - name: zmk-pmw3610-driver
      remote: 280Zo
      revision: main
    - name: prospector-zmk-module
      remote: 280Zo
      revision: main
    - name: zmk-input-processor-temp-layer-threshold
      remote: yamaryu211
      revision: main

  self:
    path: config
```
